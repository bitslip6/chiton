## yocto-3.1-sdk-gcc-9.3.0/build/conf/bblayers.conf
```bitbake
# POKY_BBLAYERS_CONF_VERSION is increased each time build/conf/bblayers.conf
# changes incompatibly
POKY_BBLAYERS_CONF_VERSION = "2"

BBPATH = "${TOPDIR}"
BBFILES ?= ""

BBLAYERS ?= " \
  /yocto/yocto-master/sources/poky/meta \
  /yocto/yocto-master/sources/poky/meta-poky \
  /yocto/yocto-master/sources/poky/meta-yocto-bsp \
  /yocto/yocto-master/sources/meta-freescale \
  /yocto/yocto-master/sources/meta-freescale-3rdparty \
  /yocto/yocto-master/sources/meta-variscite-fslc \
  "
```
