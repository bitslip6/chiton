## linux/files/meta-jabil/conf/local.conf
```bitbake
MACHINE ??= 'imx8mm-var-dart'
DISTRO ?= 'fsl-imx-wayland'
PACKAGE_CLASSES ?= "package_rpm"
EXTRA_IMAGE_FEATURES ?= "debug-tweaks"
IMAGE_ROOTFS_EXTRA_SPACE = "512000"
IMAGE_INSTALL_append = "zlib opencv opencv-dev openssl-dev addi-mod libwebsockets v4l-utils python python3 binutils dpkg rpm i2c-tools m4 make cmake mtools patch strace rpm vim cmake autoconf automake git openssl packagegroup-core-buildessential imx-gpu-sdk opencv flex bison libpng man protobuf39 protobuf39-dev protobuf39-staticdev glog35"

USER_CLASSES ?= "buildstats image-mklibs image-prelink"
PATCHRESOLVE = "noop"
BB_DISKMON_DIRS ??= "\
    STOPTASKS,${TMPDIR},2G,100K \
    STOPTASKS,${DL_DIR},2G,100K \
    STOPTASKS,${SSTATE_DIR},2G,100K \
    STOPTASKS,/tmp,200M,100K \
    ABORT,${TMPDIR},200M,1K \
    ABORT,${DL_DIR},200M,1K \
    ABORT,${SSTATE_DIR},200M,1K \
    ABORT,/tmp,20M,1K"
PACKAGECONFIG_append_pn-qemu-native = " sdl"
PACKAGECONFIG_append_pn-nativesdk-qemu = " sdl"
CONF_VERSION = "1"

DL_DIR = "/opt/yocto_downloads/"
ACCEPT_FSL_EULA = "1"

BB_NUMBER_THREADS = "19"
BB_NUMBER_PARSE_THREADS = "19"
```
